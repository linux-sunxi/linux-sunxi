## arch/arm/mach-sun4i/Kconfig
```kconfig
menu "All winner system configure"
	depends on ARCH_SUN4I

config SW_SYSMEM_RESERVED_BASE
	hex "System reserved memory(physical base addr)"
	default 0x44000000
	---help---
	  System reserved memory base

config SW_SYSMEM_RESERVED_SIZE
	int "Memory reserved size in KB"
	default 16448
	---help---
	  In KB size

config SW_DEBUG_UART
	int "UART to use for low-level debug"
	depends on DEBUG_LL
	default 0
	help
	  Choose the UART on which kernel low-level debug messages should be
	  output.

#config SW_PIN_TEST
#	tristate "Test code for PIN module"
#	default n
#	---help---
#	  "Test code for PIN module"

endmenu
```

## arch/arm/mach-sun4i/wifi/Kconfig
```kconfig
config SUN4I_RTL8192CU
	tristate "Enable RTL8192CU chip"
	depends on RTL8192CU
	default n
```

## drivers/char/sunxi_mem/Kconfig
```kconfig
#
# sunxi continous physic memory allocator.
#

config SUNXI_PHYS_MEM_ALLOCATOR
	bool "sunxi continous physic memory allocator"
	default y
	help
	Nothing help.
```

## drivers/media/video/sun5i_csi/Kconfig
```kconfig
config CSI_DEV_SEL_SUN5I
	tristate

config CSI0_SUN5I
	tristate "CSI0 v4l2 driver for sun5i"
	default m
	depends on CSI_DEV_SEL_SUN5I&&I2C && VIDEO_DEV && VIDEO_V4L2
	select VIDEOBUF_DMA_CONTIG


config CSI_OV7670
	tristate "OmniVision OV7670 sensor support"
	default m
	depends on I2C && VIDEO_V4L2
	select	CSI_DEV_SEL_SUN5I
	---help---
	  This is a Video4Linux2 sensor-level driver for the OmniVision
	  OV7670 VGA camera.

config CSI_GT2005
	tristate "GalaxyCore GT2005 2M sensor support"
	default m
	depends on I2C && VIDEO_V4L2
	select	CSI_DEV_SEL_SUN5I
	---help---
	  This is a Video4Linux2 sensor-level driver for the GalaxyCore
	  GT2005 2M camera.

config CSI_GC0308
	tristate "GalaxyCore GC0308 VGA sensor support"
	default m
	depends on I2C && VIDEO_V4L2
	select	CSI_DEV_SEL_SUN5I
	---help---
	  This is a Video4Linux2 sensor-level driver for the GalaxyCore
	  GC0308 VGA camera.

config CSI_HI704
	tristate "HYNIX HI704 VGA sensor support"
	default m
	depends on I2C && VIDEO_V4L2
	select	CSI_DEV_SEL_SUN5I
	---help---
	  This is a Video4Linux2 sensor-level driver for the Hynix
	  HI704 VGA camera.

config CSI_SP0838
	tristate "Superpix SP0838 VGA sensor support"
	default m
	depends on I2C && VIDEO_V4L2
	select	CSI_DEV_SEL_SUN5I
	---help---
	  This is a Video4Linux2 sensor-level driver for the Superpix
	  SP0838 VGA camera.

config CSI_MT9M112
	tristate "Micron MT9M112 SXGA sensor support"
	default m
	depends on I2C && VIDEO_V4L2
	select	CSI_DEV_SEL_SUN5I
	---help---
	  This is a Video4Linux2 sensor-level driver for the Micron
	  MT9M112 SXGA camera.

config CSI_MT9M113
	tristate "Micron MT9M113 SXGA sensor support"
	default m
	depends on I2C && VIDEO_V4L2
	select	CSI_DEV_SEL_SUN5I
	---help---
	  This is a Video4Linux2 sensor-level driver for the Micron
	  MT9M113 SXGA camera.

config CSI_OV2655
	tristate "OmniVision OV2655 UXGA sensor support"
	default m
	depends on I2C && VIDEO_V4L2
	select	CSI_DEV_SEL_SUN5I
	---help---
	  This is a Video4Linux2 sensor-level driver for the MOmniVision
	  OV2655 UXGA camera.

config CSI_HI253
	tristate "Hynix HI253 UXGA sensor support"
	default m
	depends on I2C && VIDEO_V4L2
	select	CSI_DEV_SEL_SUN5I
	---help---
	  This is a Video4Linux2 sensor-level driver for the Hynix
	  HI253 UXGA camera.

config CSI_MT9D112
	tristate "Micron MT9D112 UXGA sensor support"
	default m
	depends on I2C && VIDEO_V4L2
	select	CSI_DEV_SEL_SUN5I
	---help---
	  This is a Video4Linux2 sensor-level driver for the Micron
	  MT9D112 UXGA camera.

config CSI_GC0307
	tristate "GalaxyCore GC0307 VGA sensor support"
	default m
	depends on I2C && VIDEO_V4L2
	select	CSI_DEV_SEL_SUN5I
	---help---
	  This is a Video4Linux2 sensor-level driver for the GalaxyCore
	  GC0307 VGA camera.

config CSI_OV5640
	tristate "OmniVision OV5640 5M sensor support"
	default m
	depends on I2C && VIDEO_V4L2
	select	CSI_DEV_SEL_SUN5I
	---help---
	  This is a Video4Linux2 sensor-level driver for the OmniVision
	  OV5640 5M camera.

config CSI_GC2015
	tristate "GalaxyCore GC2015 2M sensor support"
	default m
	depends on I2C && VIDEO_V4L2
	select	CSI_DEV_SEL_SUN5I
	---help---
	  This is a Video4Linux2 sensor-level driver for the GalaxyCore
	  GC2015 2M camera.

config CSI_OV2643
	tristate "OmniVision OV2643 2M sensor support"
	default m
	depends on I2C && VIDEO_V4L2
	select	CSI_DEV_SEL_SUN5I
	---help---
	  This is a Video4Linux2 sensor-level driver for the OmniVision
	  OV2643 2M camera.

config CSI_GC0329
	tristate "GalaxyCore GC0329 VGA sensor support"
	default m
	depends on I2C && VIDEO_V4L2
	select	CSI_DEV_SEL_SUN5I
	---help---
	  This is a Video4Linux2 sensor-level driver for the GalaxyCore
	  GC0329 VGA camera.

config CSI_GC0309
	tristate "GalaxyCore GC0309 VGA sensor support"
	default m
	depends on I2C && VIDEO_V4L2
	select	CSI_DEV_SEL_SUN5I
	---help---
	  This is a Video4Linux2 sensor-level driver for the GalaxyCore
	  GC0309 VGA camera.
```

## drivers/net/wireless/ap6210/Kconfig
```kconfig
config AP6210
	tristate "AMPAK AP6210 wireless/bluetooth module support"
	depends on MMC
	default n
	---help---
	  This module adds support for the wireless and bluetooth
	  module of the CubieTruck.

config AP6210_FW_PATH
	depends on AP6210
	string "Firmware path"
	default "/system/vendor/modules/fw_bcmxxxx.bin"
	---help---
	  Path to the firmware file.

config AP6210_NVRAM_PATH
	depends on AP6210
	string "NVRAM path"
	default "/system/vendor/modules/nvram_apxxxx.txt"
	---help---
	  Path to the calibration file.

config AP6210_WEXT
	bool "Enable WEXT support"
	depends on AP6210 && CFG80211 = n
	select WIRELESS_EXT
	select WEXT_PRIV
	help
	  Enables WEXT support

choice
    depends on AP6210
    prompt "Interrupt type"
config AP6210_OOB
	depends on AP6210
	bool "Out-of-Band Interrupt"
	---help---
		Interrupt through WL_HOST_WAKE.
config AP6210_SDIO_IRQ
	depends on  AP6210
	bool "In-Band Interrupt"
	default y
	---help---
		Interrupt through SDIO DAT[1]
endchoice
```

## drivers/net/wireless/rt5370/Kconfig
```kconfig
config RT5370
	tristate "Ralink 3050/3052/3352 USB WiFi"
	depends on USB
    select WEXT_PRIV
	---help---
```

## drivers/power/axp_power/Kconfig
```kconfig
menuconfig AW_AXP
	bool "AXP Power drivers"
	depends on REGULATOR
	default n
	---help---
	  This option allows you to select AXP power driver

if AW_AXP

choice
	prompt "AXP PMU type"
	default AW_AXP20

config AW_AXP18
	bool "AXP18 driver"
	---help---
	  AXP18 driver

config AW_AXP19
	bool "AXP19 driver"
	---help---
	  AXP19 driver

config AW_AXP20
	bool "AXP20 driver"
	---help---
	  AXP20 driver

endchoice

config AXP_CHARGEINIT
	bool "AXP initial charging environment set"
	default y

config AXP_CHGCHANGE
	bool "AXP charging current set when suspend\resume\shutdown"
	default y
	
choice
	prompt "AXP calculate type:"
	default AW_AXP20_COU

	config AW_AXP20_COU
		bool "COULOMB"
		---help---
			AXP driver for coulomb
	config AW_AXP20_OCV
		bool "OCV"
		---help---
			AXP driver for ocv

endchoice

endif # !AW_AXP
```

## drivers/video/robopeak/Kconfig
```kconfig
menuconfig FB_RPUSBDISP
	tristate "Robopeak USB Display"
        depends on FB && m
	select FB_CFB_FILLRECT
	select FB_CFB_COPYAREA
	select FB_CFB_IMAGEBLIT
	select FB_SYS_FILLRECT
	select FB_SYS_COPYAREA
	select FB_SYS_IMAGEBLIT
	select FB_SYS_FOPS
	select FB_MODE_HELPER
	select FB_DEFERRED_IO
	help
	  Frame buffer driver for RoboPeak usb display
	  The module will be called rp_usbdisplay.

config RPUSBDISP_FPS
	int "display frame rate"
	default 16
	depends on FB_RPUSBDISP
	help
	  Specify the frame rate used by the FB_DEFERRED_IO to update
	  the display content
	  This value can be overridden by the modprobe
	  with the fps parameter 
```

## fs/overlayfs/Kconfig
```kconfig
config OVERLAYFS_FS
	tristate "Overlay filesystem support"
	help
	  Add support for overlay filesystem.
```
